## tools/embedded-display/main/Kconfig.projbuild
```kconfig
menu "Example Configuration"

    config OPENPENCIL_WIFI_SERVER
        bool "Enable OP Embedded Studio Wi-Fi content server"
        default y

    config OPENPENCIL_WIFI_LIVE_PREVIEW
        bool "Enable OP Embedded Studio volatile Wi-Fi live preview"
        depends on OPENPENCIL_WIFI_SERVER
        default n

    config OPENPENCIL_EXTERNAL_CONTENT_ONLY
        bool "Load display content from the content partition"
        default n

    config OPENPENCIL_EXTERNAL_PROTOTYPE
        bool "Allow prototype content from the content partition"
        depends on OPENPENCIL_EXTERNAL_CONTENT_ONLY
        default n

    config OPENPENCIL_SEQUENCE_PLAYBACK
        bool "Allow PNG sequence content from the content partition"
        depends on OPENPENCIL_EXTERNAL_CONTENT_ONLY || OPENPENCIL_WIFI_SERVER || OPENPENCIL_BLE_SERVER
        default n

    config OPENPENCIL_ANIMATED_PROTOTYPE
        bool "Allow PNG animation interaction content from the content partition"
        depends on OPENPENCIL_EXTERNAL_CONTENT_ONLY || OPENPENCIL_USB_CONTENT_SERVER
        default n

    config OPENPENCIL_LAN_STATUS_SCREEN
        bool "Show LAN connection details while waiting for content"
        default n

    config OPENPENCIL_SETUP_ACCESS_POINT
        bool "Enable the OP Embedded Studio setup access point"
        default y

    config OPENPENCIL_BLE_SERVER
        bool "Enable the OP Embedded Studio BLE content server"
        default n

    config OPENPENCIL_USB_CONTENT_SERVER
        bool "Enable the OP Embedded Studio USB content server"
        default n

    config OPENPENCIL_BOARD_M5STACK_STOPWATCH
        bool "Use M5Stack StopWatch board power and reset wiring"
        default n

    config OPENPENCIL_BOARD_M5STACK_CORES3
        bool "Use M5Stack CoreS3 board power, reset and touch wiring"
        default n

    config OPENPENCIL_BLE_REQUIRE_PAIRING
        bool "Require BLE link encryption before content writes"
        default y
    choice EXAMPLE_LCD_CONTROLLER
        prompt "LCD controller IC"
        default EXAMPLE_LCD_CONTROLLER_ST7789

        config EXAMPLE_LCD_CONTROLLER_ST7789
            bool "ST7789"

        config EXAMPLE_LCD_CONTROLLER_ST7735
            bool "ST7735"

        config EXAMPLE_LCD_CONTROLLER_GC9D01N
            bool "GC9D01N"

        config EXAMPLE_LCD_CONTROLLER_CO5300
            bool "CO5300 (Waveshare 1.75C QSPI)"

        config EXAMPLE_LCD_CONTROLLER_ILI9342
            bool "ILI9342C (M5Stack CoreS3)"

        config EXAMPLE_LCD_CONTROLLER_SSD1315
            bool "SSD1315/SSD1306 72x40 I2C OLED"
    endchoice

    choice OPENPENCIL_SSD1315_RENDER_MODE
        prompt "SSD1315 monochrome rendering mode"
        depends on EXAMPLE_LCD_CONTROLLER_SSD1315
        default OPENPENCIL_SSD1315_RENDER_DITHERED

        config OPENPENCIL_SSD1315_RENDER_DITHERED
            bool "Grayscale ordered dithering"

        config OPENPENCIL_SSD1315_RENDER_BINARY
            bool "Crisp black and white"
    endchoice

    config EXAMPLE_LCD_PIXEL_CLOCK_HZ
        int "LCD pixel clock in Hz"
        default 30000000 if EXAMPLE_LCD_CONTROLLER_CO5300
        default 40000000 if EXAMPLE_LCD_CONTROLLER_ILI9342
        default 10000000
        help
            SPI clock used to write pixels to the LCD panel. 10 MHz is a stable
            baseline for jumper wires and FPC adapter boards.

    config EXAMPLE_PIN_NUM_SCLK
        int "LCD SPI SCLK GPIO"
        default 12

    config EXAMPLE_PIN_NUM_MOSI
        int "LCD SPI MOSI GPIO"
        default 11

    config EXAMPLE_PIN_NUM_MISO
        int "LCD SPI MISO GPIO (-1 if unused)"
        default -1

    config EXAMPLE_PIN_NUM_LCD_DC
        int "LCD DC GPIO"
        default 9

    config EXAMPLE_PIN_NUM_LCD_RST
        int "LCD reset GPIO (-1 if unused)"
        default 1 if EXAMPLE_LCD_CONTROLLER_CO5300
        default 14

    config EXAMPLE_PIN_NUM_LCD_CS
        int "LCD CS GPIO"
        default 12 if EXAMPLE_LCD_CONTROLLER_CO5300
        default 10

    config EXAMPLE_PIN_NUM_LCD_TE
        int "LCD tearing-effect GPIO (-1 if unused)"
        default 13 if EXAMPLE_LCD_CONTROLLER_CO5300
        default -1
        help
            Optional tearing-effect signal used to align full-frame transfers
            with the panel refresh cycle. The Waveshare CO5300 board routes
            LCD_TE to GPIO13.

    config EXAMPLE_PIN_NUM_I2C_SDA
        int "OLED I2C SDA GPIO"
        default 5

    config EXAMPLE_PIN_NUM_I2C_SCL
        int "OLED I2C SCL GPIO"
        default 6

    config EXAMPLE_LCD_I2C_ADDRESS
        int "OLED 7-bit I2C address"
        range 1 126
        default 60

    config EXAMPLE_LCD_I2C_FREQ_HZ
        int "OLED I2C clock in Hz"
        default 400000

    config EXAMPLE_LCD_COLUMN_OFFSET
        int "OLED controller RAM column offset"
        range 0 127
        default 28

    config EXAMPLE_PIN_NUM_QSPI_PCLK
        int "LCD QSPI clock GPIO"
        default 38

    config EXAMPLE_PIN_NUM_QSPI_DATA0
        int "LCD QSPI data 0 GPIO"
        default 4

    config EXAMPLE_PIN_NUM_QSPI_DATA1
        int "LCD QSPI data 1 GPIO"
        default 5

    config EXAMPLE_PIN_NUM_QSPI_DATA2
        int "LCD QSPI data 2 GPIO"
        default 6

    config EXAMPLE_PIN_NUM_QSPI_DATA3
        int "LCD QSPI data 3 GPIO"
        default 7

    config EXAMPLE_PIN_NUM_BK_LIGHT
        int "LCD backlight GPIO (-1 if tied on)"
        default -1

    config EXAMPLE_LCD_BK_LIGHT_ON_LEVEL
        int "Backlight ON level"
        range 0 1
        default 1

    config EXAMPLE_LCD_H_RES
        int "LCD horizontal resolution"
        default 240 if EXAMPLE_LCD_CONTROLLER_ST7789
        default 128 if EXAMPLE_LCD_CONTROLLER_ST7735
        default 160 if EXAMPLE_LCD_CONTROLLER_GC9D01N
        default 466 if EXAMPLE_LCD_CONTROLLER_CO5300
        default 320 if EXAMPLE_LCD_CONTROLLER_ILI9342
        default 72 if EXAMPLE_LCD_CONTROLLER_SSD1315

    config EXAMPLE_LCD_V_RES
        int "LCD vertical resolution"
        default 240 if EXAMPLE_LCD_CONTROLLER_ST7789
        default 128 if EXAMPLE_LCD_CONTROLLER_ST7735
        default 160 if EXAMPLE_LCD_CONTROLLER_GC9D01N
        default 466 if EXAMPLE_LCD_CONTROLLER_CO5300
        default 240 if EXAMPLE_LCD_CONTROLLER_ILI9342
        default 40 if EXAMPLE_LCD_CONTROLLER_SSD1315

    config EXAMPLE_LCD_X_GAP
        int "LCD X gap/offset"
        default 6 if EXAMPLE_LCD_CONTROLLER_CO5300
        default 0

    config EXAMPLE_LCD_Y_GAP
        int "LCD Y gap/offset"
        default 0

    config EXAMPLE_LCD_MIRROR_X
        bool "Mirror LCD on X axis"
        default n

    config EXAMPLE_LCD_MIRROR_Y
        bool "Mirror LCD on Y axis"
        default n

    config EXAMPLE_LCD_SWAP_XY
        bool "Swap LCD X/Y axes"
        default n

    config EXAMPLE_LCD_INVERT_COLOR
        bool "Invert LCD colors"
        default y if EXAMPLE_LCD_CONTROLLER_ST7789
        default n if EXAMPLE_LCD_CONTROLLER_ST7735
        default n if EXAMPLE_LCD_CONTROLLER_GC9D01N
        default n if EXAMPLE_LCD_CONTROLLER_CO5300
        default y if EXAMPLE_LCD_CONTROLLER_ILI9342

    choice EXAMPLE_LCD_RGB_ORDER
        prompt "LCD RGB element order"
        default EXAMPLE_LCD_RGB_ORDER_RGB

        config EXAMPLE_LCD_RGB_ORDER_RGB
            bool "RGB"

        config EXAMPLE_LCD_RGB_ORDER_BGR
            bool "BGR"
    endchoice

endmenu
```
